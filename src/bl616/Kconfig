## src/bl616/Kconfig
```kconfig
mainmenu "SDK Configuration"

source "$BL_SDK_BASE/Kconfig"

config CHERRYUSB_HOST_XBOX
		bool "Xbox host class"
		default n
		depends on CHERRYUSB_HOST
		help
			Build the Xbox controller host class.
```

## src/bl616/defconfig
```kconfig
# Components
CONFIG_BFLB_LOG=n
CONFIG_FREERTOS=y
CONFIG_POSIX=y
CONFIG_TLSF=y
CONFIG_SHELL=y
CONFIG_LWIP=y
CONFIG_RF=y
CONFIG_MBEDTLS=y
CONFIG_DHCPD=y
CONFIG_PING=y
CONFIG_WIFI6=y
CONFIG_MACSW_SELECT=default
CONFIG_FHOST=y
CONFIG_VSNPRINTF_FLOAT=y
CONFIG_VSNPRINTF_FLOAT_EX=y
CONFIG_VSNPRINTF_LONG_LONG=y
CONFIG_MBEDTLS_AES_USE_HW=y
CONFIG_MBEDTLS_BIGNUM_USE_HW=y
CONFIG_MBEDTLS_ECC_USE_HW=y
CONFIG_MBEDTLS_SHA1_USE_HW=y
CONFIG_MBEDTLS_SHA256_USE_HW=y
CONFIG_MBEDTLS_SHA512_USE_HW=y
CONFIG_WIFI_IPERF=n
CONFIG_IPERF=y
CONFIG_CHERRYUSB=y
CONFIG_CHERRYUSB_OSAL=freertos
CONFIG_CHERRYUSB_DEVICE=y
CONFIG_CHERRYUSB_DEVICE_HID=y
CONFIG_CHERRYUSB_HOST=y
CONFIG_CHERRYUSB_HOST_HID=y
CONFIG_CHERRYUSB_HOST_MSC=y
CONFIG_CHERRYUSB_HOST_RTL8152=y
CONFIG_CHERRYUSB_HOST_ASIX=y
CONFIG_BSP_SDH_SD=y
CONFIG_BSP_SDH_SDCARD=y
CONFIG_BSP_SDH_OSAL_POLLING_MODE=n
# CONFIG_BSP_SDH_LOG_LEVEL=5
CONFIG_FATFS=y
CONFIG_FATFS_USBH=y
CONFIG_FATFS_SDH_SDCARD=y
# CONFIG_CONSOLE_WO=y
```
